/*
 * Copyright (c) 2020 The ZMK Contributors
 *
 * SPDX-License-Identifier: MIT
 */

#include "microdox.dtsi"
#include "microdox_cirque.dtsi"
#include <input/processors.dtsi>
#include <dt-bindings/zmk/input_transform.h>

&glidepoint_listener {
  status = "okay";
  input-processors = <&zip_xy_scaler 5 2>;

  /* When mouse layer is active, convert movement into scroll instead */
  scroll_override {
    layers = <5>; /* your MOU_LAY */
    input-processors = <&zip_xy_transform (INPUT_TRANSFORM_Y_INVERT)
                        &zip_xy_to_scroll_mapper
                        &zip_scroll_scaler 4 16>;
  };
};

&kscan0 {
    col-gpios
        = <&pro_micro 21 GPIO_ACTIVE_HIGH>
        , <&pro_micro 20 GPIO_ACTIVE_HIGH>
        , <&pro_micro 19 GPIO_ACTIVE_HIGH>
        , <&pro_micro 18 GPIO_ACTIVE_HIGH>
        , <&pro_micro 15 GPIO_ACTIVE_HIGH>
        ;
};
